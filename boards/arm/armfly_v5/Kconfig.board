## boards/arm/armfly_v5/Kconfig.board
```kconfig
# NUCLEO-64 F401RE board configuration

# Copyright (c) 2016 Linaro Limited.
# SPDX-License-Identifier: Apache-2.0

config BOARD_ARMFLY_V5
	bool "armfly v5 Development Board"
	depends on SOC_STM32F407XE
```

## boards/arm/armfly_v5/Kconfig.defconfig
```kconfig
# NUCLEO-64 F401RE board configuration

# Copyright (c) 2016 Linaro Limited.
# Copyright (c) 2019 Centaur Analytics, Inc
# SPDX-License-Identifier: Apache-2.0

if BOARD_ARMFLY_V5

config BOARD
	default "armfly_v5"


endif # BOARD_ARMFLY_V5
```

## dts/bindings/display/chipone,co5300.yaml
```yaml
description: Chipone CO5300 display controller

compatible: "chipone,co5300"

include: [mipi-dbi-spi-device.yaml, display-controller.yaml]

properties:
  reg:
    required: true
    description: SPI chip select number

  reset-gpios:
    type: phandle-array
    description: GPIO connected to the reset pin

  #spi-max-frequency:
  #  required: true
  #  description: Maximum SPI clock frequency in Hz
  #  type: int
  #  minimum: 1000000
  #  maximum: 48000000
#
  #cmd-data-gpios:
  #  type: phandle-array
  #  required: true
  #  description: GPIO connected to the DC (Data/Command) pin
#
#
  #width:
  #  type: int
  #  required: true
  #  description: Display width in pixels
  #  minimum: 1
  #  maximum: 240
#
  #height:
  #  type: int
  #  required: true
  #  description: Display height in pixels
  #  minimum: 1
  #  maximum: 320
#
  #rotation:
  #  type: int
  #  required: false
  #  description: Display rotation in degrees
  #  enum: [0, 90, 180, 270]
  #  default: 0
#
  #pixel-format:
  #  type: string
  #  required: false
  #  description: Display pixel format
  #  enum: ["RGB565", "RGB888"]
  #  default: "RGB565"
  avdd-enable-gpios:
    type: phandle-array
    required: false
    description: avdd enable GPIO specification, active high

  mipi-mode:
    required: true
```
